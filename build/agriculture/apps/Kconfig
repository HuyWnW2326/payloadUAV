## build/agriculture/apps/Kconfig
```kconfig
source "/home/huy/CTUAV/payloadUAV/build/agriculture/apps/_home_huy_CTUAV_payloadUAV_apps_audioutils_Kconfig"
source "/home/huy/CTUAV/payloadUAV/build/agriculture/apps/_home_huy_CTUAV_payloadUAV_apps_benchmarks_Kconfig"
source "/home/huy/CTUAV/payloadUAV/build/agriculture/apps/_home_huy_CTUAV_payloadUAV_apps_boot_Kconfig"
source "/home/huy/CTUAV/payloadUAV/build/agriculture/apps/_home_huy_CTUAV_payloadUAV_apps_canutils_Kconfig"
source "/home/huy/CTUAV/payloadUAV/build/agriculture/apps/_home_huy_CTUAV_payloadUAV_apps_crypto_Kconfig"
source "/home/huy/CTUAV/payloadUAV/build/agriculture/apps/_home_huy_CTUAV_payloadUAV_apps_examples_Kconfig"
source "/home/huy/CTUAV/payloadUAV/build/agriculture/apps/_home_huy_CTUAV_payloadUAV_apps_fsutils_Kconfig"
source "/home/huy/CTUAV/payloadUAV/build/agriculture/apps/_home_huy_CTUAV_payloadUAV_apps_games_Kconfig"
source "/home/huy/CTUAV/payloadUAV/build/agriculture/apps/_home_huy_CTUAV_payloadUAV_apps_graphics_Kconfig"
source "/home/huy/CTUAV/payloadUAV/build/agriculture/apps/_home_huy_CTUAV_payloadUAV_apps_industry_Kconfig"
source "/home/huy/CTUAV/payloadUAV/build/agriculture/apps/_home_huy_CTUAV_payloadUAV_apps_interpreters_Kconfig"
source "/home/huy/CTUAV/payloadUAV/build/agriculture/apps/_home_huy_CTUAV_payloadUAV_apps_logging_Kconfig"
source "/home/huy/CTUAV/payloadUAV/build/agriculture/apps/_home_huy_CTUAV_payloadUAV_apps_lte_Kconfig"
source "/home/huy/CTUAV/payloadUAV/build/agriculture/apps/_home_huy_CTUAV_payloadUAV_apps_math_Kconfig"
source "/home/huy/CTUAV/payloadUAV/build/agriculture/apps/_home_huy_CTUAV_payloadUAV_apps_mlearning_Kconfig"
source "/home/huy/CTUAV/payloadUAV/build/agriculture/apps/_home_huy_CTUAV_payloadUAV_apps_netutils_Kconfig"
source "/home/huy/CTUAV/payloadUAV/apps/nshlib/Kconfig"
source "/home/huy/CTUAV/payloadUAV/apps/platform/Kconfig"
source "/home/huy/CTUAV/payloadUAV/build/agriculture/apps/_home_huy_CTUAV_payloadUAV_apps_sdr_Kconfig"
source "/home/huy/CTUAV/payloadUAV/build/agriculture/apps/_home_huy_CTUAV_payloadUAV_apps_system_Kconfig"
source "/home/huy/CTUAV/payloadUAV/build/agriculture/apps/_home_huy_CTUAV_payloadUAV_apps_tee_Kconfig"
source "/home/huy/CTUAV/payloadUAV/build/agriculture/apps/_home_huy_CTUAV_payloadUAV_apps_testing_Kconfig"
source "/home/huy/CTUAV/payloadUAV/apps/tools/Kconfig"
source "/home/huy/CTUAV/payloadUAV/build/agriculture/apps/_home_huy_CTUAV_payloadUAV_apps_videoutils_Kconfig"
source "/home/huy/CTUAV/payloadUAV/build/agriculture/apps/_home_huy_CTUAV_payloadUAV_apps_wireless_Kconfig"
```
